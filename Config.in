## Config.in
```kconfig
menu "XFH recovery applications"
source "$(BR2_EXTERNAL_XFHRECOVERY_PATH)/package/xfh-ui/Config.in"
endmenu
```

## configs/xfh_recovery_defconfig
```kconfig
# Minimal 32-bit ARM926EJ-S soft-float Linux; no LCD dependency.
BR2_arm=y
BR2_arm926t=y
BR2_TOOLCHAIN_BUILDROOT_MUSL=y
BR2_TARGET_GENERIC_HOSTNAME="xfh-recovery"
BR2_TARGET_GENERIC_ISSUE="XFH-50PMB read-only recovery"
BR2_TARGET_GENERIC_GETTY_PORT="ttyS2"
BR2_TARGET_GENERIC_GETTY_BAUDRATE_115200=y
BR2_ROOTFS_OVERLAY="$(BR2_EXTERNAL_XFHRECOVERY_PATH)/board/xfh/rootfs-overlay"

BR2_KERNEL_HEADERS_AS_KERNEL=y
BR2_PACKAGE_HOST_LINUX_HEADERS_CUSTOM_6_6=y
BR2_LINUX_KERNEL=y
BR2_LINUX_KERNEL_CUSTOM_VERSION=y
BR2_LINUX_KERNEL_CUSTOM_VERSION_VALUE="6.6.143"
BR2_LINUX_KERNEL_USE_DEFCONFIG=y
BR2_LINUX_KERNEL_DEFCONFIG="sunxi"
BR2_LINUX_KERNEL_CONFIG_FRAGMENT_FILES="$(BR2_EXTERNAL_XFHRECOVERY_PATH)/board/xfh/linux.fragment"
BR2_LINUX_KERNEL_ZIMAGE=y
BR2_LINUX_KERNEL_DTS_SUPPORT=y
BR2_LINUX_KERNEL_INTREE_DTS_NAME="allwinner/suniv-f1c100s-xfh50pmb"

BR2_TARGET_UBOOT=y
BR2_TARGET_UBOOT_BUILD_SYSTEM_KCONFIG=y
BR2_TARGET_UBOOT_CUSTOM_VERSION=y
BR2_TARGET_UBOOT_CUSTOM_VERSION_VALUE="2023.04"
BR2_TARGET_UBOOT_BOARD_DEFCONFIG="xfh50pmb"
BR2_TARGET_UBOOT_NEEDS_DTC=y
BR2_TARGET_UBOOT_NEEDS_PYLIBFDT=y
BR2_TARGET_UBOOT_FORMAT_CUSTOM=y
BR2_TARGET_UBOOT_FORMAT_CUSTOM_NAME="u-boot-sunxi-with-spl.bin"

BR2_TARGET_ROOTFS_EXT2=y
BR2_TARGET_ROOTFS_EXT2_4=y
BR2_TARGET_ROOTFS_EXT2_SIZE="128M"
# BR2_TARGET_ROOTFS_TAR is not set
BR2_ROOTFS_POST_IMAGE_SCRIPT="$(BR2_EXTERNAL_XFHRECOVERY_PATH)/board/xfh/post-image.sh"
BR2_PACKAGE_HOST_GENIMAGE=y
BR2_PACKAGE_HOST_MTOOLS=y
BR2_PACKAGE_HOST_UBOOT_TOOLS=y

BR2_PACKAGE_XFH_UI=y
```

## package/xfh-ui/Config.in
```kconfig
config BR2_PACKAGE_XFH_UI
    bool "XFH framebuffer storage selector"
    depends on BR2_USE_MMU
    help
      A small, read-only framebuffer storage selection panel with
      terminal fallback. Does not erase, mount writable or program flash.
```
